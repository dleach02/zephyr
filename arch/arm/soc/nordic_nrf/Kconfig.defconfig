## arch/arm/soc/nordic_nrf/Kconfig.defconfig
```kconfig
# Kconfig.defconfig - Nordic Semiconductor nRFx MCU line
#
# Copyright (c) 2016-2018 Nordic Semiconductor ASA
#
# SPDX-License-Identifier: Apache-2.0
#

if SOC_FAMILY_NRF

source "arch/arm/soc/nordic_nrf/*/Kconfig.defconfig.series"

config BUILD_OUTPUT_HEX
	default y

if SERIAL

config GPIO
	default y

endif # SERIAL

if GPIO

config GPIO_NRFX
	default y

endif # GPIO

if FLASH

config SOC_FLASH_NRF
	def_bool y

endif # FLASH

if BT_CTLR
choice BT_LL_SW_TYPE
	default BT_LL_SW
endchoice
endif # BT_CTLR

endif # SOC_FAMILY_NRF
```

## drivers/entropy/Kconfig.rv32m1_ri5cy
```kconfig
# Kconfig.rv32m1_riscy - RV32M1 RI5CY entropy generator driver configuration
#
# Copyright (c) 2016 ARM Ltd.
#
# SPDX-License-Identifier: Apache-2.0


menuconfig ENTROPY_RV32M1_TRNG
	bool "RV32M1 TRNG driver"
	depends on ENTROPY_GENERATOR && HAS_RV32M1_TRNG
	select ENTROPY_HAS_DRIVER
	select HAS_DTS_ENTROPY
	help
	  This option enables the true random number generator (TRNG)
	  driver based on the RV32M1 TRNG driver.
```

## dts/bindings/flash_controller/openisa,rv32m1-ftfe.yaml
```yaml
---
title: OpenISA RV32M1 Flash Memory Module (FTFE)
version: 0.1

description: >
    This binding gives for the OpenISA RV32M1 Flash Memory Module E (FTFE)

inherits:
    !include flash-controller.yaml

properties:
  compatible:
    constraint: "openisa,rv32m1-ftfe"

  clocks:
      type: array
      category: optional
      description: Clock gate information
      generation: define


...
```

## modules/Kconfig.nxp
```kconfig
#
# Copyright (c) 2019 NXP Semiconductor
#
# SPDX-License-Identifier: Apache-2.0
#

config HAS_NXP_DRIVERS
	bool
```

## subsys/bluetooth/controller/hci/rv32m1/Kconfig
```kconfig
# Kconfig - Bluetooth Controller configuration options
#
# Copyright (c) 2018 Linaro Limited
# Copyright (c) 2018 NXP Corporation
#
# SPDX-License-Identifier: Apache-2.0
#

comment "RV32M1 BLE Controller support"


if BT_LL_RV32M1

# RV32M1 Link Layer Controller settings

config RV32M1_NUM_TIMERS
	int
	default 1
	help
	  Select the number of timer service timers.

config RV32M1_CTRL_PRIO
	int
	default 1
	help
	  Select the priority level the controller task shall run at.
	  Should be set higher than host layer protocol stacks.

config RV32M1_CTRL_STACK_SIZE
	# Hidden option for Controller's Co-Operative high priority thread
	# stack size.
	int
	default 1200

config RV32M1_COEX_RF_DENY_ACTIVE_STATE
	# Need to consider using a config for gMWS_UseCoexistence_d
	# but for now this is is the pin polarity.
	int
	default 1
	help
	  Coexistence RF Deny pin polarity:
	    1 - for active on logic one;
	    0 - active on logic zero

config RV32M1_ADVERTISING_DEFAULT_TX_POWER
	int
	default 20
	help
	  Default Tx Power on the advertising channel.
	  For MRV32M1Z BLE controller there are 32 possible power
	  levels 0 <= N <= 31 for which the output power is distributed
	  evenly between minimum and maximum power levels.
	  For further details see the silicon datasheet.

config RV32M1_CONNECTION_DEFAULT_TX_POWER
	int
	default 20
	help
	  Default Tx Power on the connection channel.
	  For MKW41Z BLE controller there are 32 possible power
	  levels 0 <= N <= 31 for which the output power is distributed
	  evenly between minimum and maximum power levels.
	  For further details see the silicon datasheet.

config RV32M1_MCU_SLEEP_DURING_BLE_EVENTS
	bool
	default y
	help
	   Enable/Disable MCU Sleep During BLE Events

config RV32M1_ADVERTISING_PACKET_INTERVAL
	int
	default 8
	help
	  Time between the beginning of two consecutive advertising PDU's
	  Time = ADVERTISING_PACKET_INTERVAL * 0.625msec
	  Time range <= 10msec

config RV32M1_SCAN_CHANNEL_MAP
	hex
	default 0x07
	help
	  Advertising channels that are enabled for scanning operation.
	  Range 0x01 - 0x07
	  0x01 - Enables channel 37 for use.
	  0x02 - Enables channel 38 for use.
	  0x04 - Enables channel 39 for use.

config RV32M1_INITIATOR_CHANNEL_MAP
	hex
	default 0x07
	help
	  Advertising channels that are enabled for initiator scanning operation.
	  Range 0x01 - 0x07
	  0x01 - Enables channel 37 for use.
	  0x02 - Enables channel 38 for use.
	  0x04 - Enables channel 39 for use.

config RV32M1_OFFSET_TO_FIRST_INSTANT
	hex
	default 0xFFFF
	help
	  Offset to the first instant register. Units in 625uS time slots.

	  Ex. If current clock value is 0x0004 and offset is 0x0008, then
	  the first event will begin when clock value becomes 0x000C.

	  A value of 0xFFFF will be ignored and default value (0x0006)
	  will be set.

config RV32M1_XTAL_TRIM
	hex
	default 0xFF
	help
	  Measured trim value for tuning XTAL.

config RV32M1_MEM_USAGE_STATS
	bool "Enable RV32M1 Framework memory usage statistics"
	help
	  Turn on RV32M1 Framework memory usage statistics.

config RV32M1_POOL_32_CNT
	int
	default 6
	help
	  Count of 32 byte buffer blocks available to the RV32M1 BLE Link Layer
	  controller.

	  If an allocation error is indicated then increase this number.

config RV32M1_POOL_64_CNT
	int
	default 64
	help
	  Count of 64 byte buffer blocks available to the RV32M1 BLE Link Layer
	  controller.

	  If an allocation error is indicated then increase this number.

config RV32M1_POOL_128_CNT
	int
	default 4
	help
	  Count of 128 byte buffer blocks available to the RV32M1 BLE Link Layer
	  controller.

	  If an allocation error is indicated then increase this number.

config RV32M1_POOL_256_CNT
	int
	default 2
	help
	  Count of 256 byte buffer blocks available to the RV32M1 BLE Link Layer
	  controller.

	  If an allocation error is indicated then increase this number.

config RV32M1_POOL_512_CNT
	int
	default 0
	help
	  Count of 512 byte buffer blocks available to the RV32M1 BLE Link Layer
	  controller.

	  If an allocation error is indicated then increase this number.

config RV32M1_POOL_1024_CNT
	int
	default 0
	help
	  Count of 1024 byte buffer blocks available to the RV32M1 BLE Link Layer
	  controller.

	  If an allocation error is indicated then increase this number.

endif # BT_LL_RV32M1Z
```
